## main/Kconfig.projbuild
```kconfig
menu "Camera example"
config CAMERA_AP_SSID
    string "2.4 GHz access point SSID"
    default "EdgeZ-Camera"
config CAMERA_AP_PASSWORD
    string "2.4 GHz access point password (8-63 characters)"
    default "edgez-camera"
endmenu
```

## sdkconfig.defaults
```kconfig
CONFIG_IDF_TARGET="esp32s3"
CONFIG_ESPTOOLPY_FLASHSIZE_16MB=y
CONFIG_PARTITION_TABLE_CUSTOM=y
CONFIG_PARTITION_TABLE_CUSTOM_FILENAME="partitions.csv"
CONFIG_SPIRAM=y
CONFIG_SPIRAM_MODE_OCT=y
CONFIG_SPIRAM_TYPE_AUTO=y
CONFIG_SPIRAM_CLK_IO=30
CONFIG_SPIRAM_CS_IO=26
CONFIG_SPIRAM_SPEED_80M=y
CONFIG_SPIRAM_BOOT_INIT=y
CONFIG_SPIRAM_USE_MALLOC=y
CONFIG_SPIRAM_IGNORE_NOTFOUND=y
CONFIG_SPIRAM_MALLOC_ALWAYSINTERNAL=16384
CONFIG_SPIRAM_MALLOC_RESERVE_INTERNAL=32768
CONFIG_COMPILER_OPTIMIZATION_PERF=y
CONFIG_ESP_MAIN_TASK_STACK_SIZE=8192
CONFIG_FREERTOS_HZ=1000
CONFIG_HALOW_TRANSPORT_SPI=y
CONFIG_MM_CHIP_MM6108=y
CONFIG_MM_BCF_FILE="bcf_fgh100mhaamd.mbin"
CONFIG_MM_RESET_N=8
CONFIG_MM_WAKE=9
CONFIG_MM_BUSY=7
CONFIG_MM_SPI_SCK=4
CONFIG_MM_SPI_MOSI=3
CONFIG_MM_SPI_MISO=5
CONFIG_MM_SPI_CS=2
CONFIG_MM_SPI_IRQ=6
CONFIG_MMPKTMEM_TX_POOL_N_BLOCKS=24
CONFIG_MMPKTMEM_RX_POOL_N_BLOCKS=24
CONFIG_HALOW_MESH_MODE=y
CONFIG_HALOW_MESH_AUTO_JOIN=n
CONFIG_HALOW_BLE_PROVISIONING=n
CONFIG_HALOW_EDGEZ_MQTT_RELAY=n
CONFIG_HALOW_MESH_FREQUENCY_KHZ=914500
CONFIG_HALOW_MESH_BANDWIDTH_MHZ=1
CONFIG_HALOW_COUNTRY_CODE="US"
CONFIG_LOG_DEFAULT_LEVEL_INFO=y
CONFIG_HTTPD_MAX_REQ_HDR_LEN=1024
```

## zephyr/Kconfig
```kconfig
config MBEDTLS_ZEPHYR_ENTROPY
    bool
source "Kconfig.zephyr"
config WIFI_SSID
    string "HaLow identity (unused by the camera protocol)"
    default "edgez-camera"
config WIFI_PSK
    string "HaLow PSK (unused by the camera protocol)"
    default ""
config CAMERA_UART_BAUD
    int "Camera UART baud rate"
    default 921600
config CAMERA_DTIM_SLEEP
    bool "Use the LED example's native AP/STA DTIM sleep contract"
    default y
config OFFGRID_NRF54_SENSOR_SPI_IRQ_SLEEP_NOPULL
    bool
    default y
config OFFGRID_NRF54_SENSOR_SPI_SLEEP_PINS
    bool
    default y

config CAMERA_DUMMY_IMAGE
    bool "Send deterministic JPEG test blocks instead of capturing a camera image"
    default n

config CAMERA_JPEG_RING_KB
    int "JPEG block ring payload capacity in KiB"
    range 2 32
    default 32
    help
      Bounded queue between the camera UART producer and radio block consumer.
      Use 16 or 32 KiB for larger captures. Metadata and the retry cache use
      additional RAM; UART DMA uses a separate byte ring.
```
